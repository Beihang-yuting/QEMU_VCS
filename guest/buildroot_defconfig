## guest/buildroot_defconfig
```kconfig
# CoSim Platform 精简 buildroot defconfig
# 基于 qemu_x86_64_defconfig，仅保留 cosim 测试所需组件
# 用法: cp guest/buildroot_defconfig .config && make -j$(nproc)

# Architecture
BR2_x86_64=y

# Toolchain
BR2_TOOLCHAIN_BUILDROOT_GLIBC=y

# Kernel
BR2_LINUX_KERNEL=y
BR2_LINUX_KERNEL_USE_ARCH_DEFAULT_CONFIG=y
BR2_LINUX_KERNEL_IMAGE_BZIMAGE=y

# Filesystem
BR2_TARGET_ROOTFS_EXT2=y
BR2_TARGET_ROOTFS_EXT2_4=y
BR2_TARGET_ROOTFS_EXT2_SIZE="64M"

# System
BR2_TARGET_GENERIC_HOSTNAME="cosim-guest"
BR2_TARGET_GENERIC_ISSUE="CoSim Guest Linux"
BR2_SYSTEM_DHCP="eth0"
BR2_TARGET_GENERIC_ROOT_PASSWD=""
BR2_TARGET_GENERIC_GETTY_PORT="ttyS0"
BR2_TARGET_GENERIC_GETTY_BAUDRATE_115200=y

# 网络测试工具
BR2_PACKAGE_IPERF3=y
BR2_PACKAGE_BUSYBOX_SHOW_OTHERS=y
BR2_PACKAGE_IPROUTE2=y
BR2_PACKAGE_IPUTILS=y
BR2_PACKAGE_ETHTOOL=y
```
